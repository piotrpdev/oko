## camera/sdkconfig.defaults
```kconfig
CONFIG_ESP_MAIN_TASK_STACK_SIZE=10000

CONFIG_ESP_SYSTEM_EVENT_TASK_STACK_SIZE=10000
CONFIG_PTHREAD_TASK_STACK_SIZE_DEFAULT=10000

# Use this to set FreeRTOS kernel tick frequency to 1000 Hz (100 Hz by default).
# This allows to use 1 ms granularity for thread sleeps (10 ms by default).
#CONFIG_FREERTOS_HZ=1000

CONFIG_HTTPD_MAX_REQ_HDR_LEN=1024

CONFIG_ESP32_SPIRAM_SUPPORT=y
CONFIG_SPIRAM_ALLOW_STACK_EXTERNAL_MEMORY=y
# CONFIG_LOG_DEFAULT_LEVEL_DEBUG=y

# Workaround for https://github.com/espressif/esp-idf/issues/7631
#CONFIG_MBEDTLS_CERTIFICATE_BUNDLE=n
#CONFIG_MBEDTLS_CERTIFICATE_BUNDLE_DEFAULT_FULL=n
```
